;===========================================================
;================== Dream FM  2021 =========================
;================== coder stereo     =======================
;==================  SIN_DATA.inc    =======================
;===========================================================
;Tablica sinusa dla 158 elementow,7bit (6004MHz/158 = 38kHz)
;Wartosci przesuniete w lewo o jeden bit za bitem.2 (OC1)
;dodatkowo kolejnosc bitow jest odwrocona (PCB friendly ;) )
;sinus nie jest idelnie symetryczny czasowo (roznica 1 indexu)
;co powoduje ze generowany sygnal przez dac na MSB nie pokrywa 
;sie idealnie na jednym ze zboczy

;=============================
 .EQU	SIN0=	0b11110111;127
 .EQU	SIN1=	0b11110111;127
 .EQU	SIN2=	0b11110111;127
 .EQU	SIN3=	0b01110111;126
 .EQU	SIN4=	0b01110111;126
 .EQU	SIN5=	0b10110111;125
 .EQU	SIN6=	0b10110111;125
 .EQU	SIN7=	0b00110111;124
 .EQU	SIN8=	0b11010111;123
 .EQU	SIN9=	0b11010111;123
 .EQU	SIN10=	0b01010111;122
 .EQU	SIN11=	0b00010111;120
 .EQU	SIN12=	0b11100111;119
 .EQU	SIN13=	0b01100111;118
 .EQU	SIN14=	0b10100111;117
 .EQU	SIN15=	0b11000111;115
 .EQU	SIN16=	0b01000111;114
 .EQU	SIN17=	0b00000111;112
 .EQU	SIN18=	0b11110011;111
 .EQU	SIN19=	0b10110011;109
 .EQU	SIN20=	0b11010011;107
 .EQU	SIN21=	0b10010011;105
 .EQU	SIN22=	0b11100011;103
 .EQU	SIN23=	0b10100011;101
 .EQU	SIN24=	0b11000011;99
 .EQU	SIN25=	0b10000011;97
 .EQU	SIN26=	0b11110101;95
 .EQU	SIN27=	0b10110101;93
 .EQU	SIN28=	0b01010101;90
 .EQU	SIN29=	0b00010101;88
 .EQU	SIN30=	0b01100101;86
 .EQU	SIN31=	0b11000101;83
 .EQU	SIN32=	0b10000101;81
 .EQU	SIN33=	0b11110001;79
 .EQU	SIN34=	0b00110001;76
 .EQU	SIN35=	0b01010001;74
 .EQU	SIN36=	0b11100001;71
 .EQU	SIN37=	0b10100001;69
 .EQU	SIN38=	0b01000001;66
 .EQU	SIN39=	0b00000001;64
 .EQU	SIN40=	0b10110110;61
 .EQU	SIN41=	0b01010110;58
 .EQU	SIN42=	0b00010110;56
 .EQU	SIN43=	0b10100110;53
 .EQU	SIN44=	0b11000110;51
 .EQU	SIN45=	0b00000110;48
 .EQU	SIN46=	0b01110010;46
 .EQU	SIN47=	0b00110010;44
 .EQU	SIN48=	0b10010010;41
 .EQU	SIN49=	0b11100010;39
 .EQU	SIN50=	0b10100010;37
 .EQU	SIN51=	0b01000010;34
 .EQU	SIN52=	0b00000010;32
 .EQU	SIN53=	0b01110100;30
 .EQU	SIN54=	0b00110100;28
 .EQU	SIN55=	0b01010100;26
 .EQU	SIN56=	0b00010100;24
 .EQU	SIN57=	0b01100100;22
 .EQU	SIN58=	0b00100100;20
 .EQU	SIN59=	0b01000100;18
 .EQU	SIN60=	0b00000100;16
 .EQU	SIN61=	0b11110000;15
 .EQU	SIN62=	0b10110000;13
 .EQU	SIN63=	0b00110000;12
 .EQU	SIN64=	0b01010000;10
 .EQU	SIN65=	0b10010000;9
 .EQU	SIN66=	0b00010000;8
 .EQU	SIN67=	0b11100000;7
 .EQU	SIN68=	0b10100000;5
 .EQU	SIN69=	0b00100000;4
 .EQU	SIN70=	0b00100000;4
 .EQU	SIN71=	0b11000000;3
 .EQU	SIN72=	0b01000000;2
 .EQU	SIN73=	0b01000000;2
 .EQU	SIN74=	0b10000000;1
 .EQU	SIN75=	0b10000000;1
 .EQU	SIN76=	0b00000000;0
 .EQU	SIN77=	0b00000000;0
 .EQU	SIN78=	0b00000000;0

 .EQU	SIN79=	SIN78
 .EQU	SIN80=	SIN77
 .EQU	SIN81=	SIN76;0
 .EQU	SIN82=	SIN75;1
 .EQU	SIN83=	SIN74;1
 .EQU	SIN84=	SIN73;2
 .EQU	SIN85=	SIN72;2
 .EQU	SIN86=	SIN71;3
 .EQU	SIN87=	SIN70;4
 .EQU	SIN88=	SIN69;4
 .EQU	SIN89=	SIN68;5
 .EQU	SIN90=	SIN67;7
 .EQU	SIN91=	SIN66;8
 .EQU	SIN92=	SIN65;9
 .EQU	SIN93=	SIN64;10
 .EQU	SIN94=	SIN63;12
 .EQU	SIN95=	SIN62;13
 .EQU	SIN96=	SIN61;15
 .EQU	SIN97=	SIN60;16
 .EQU	SIN98=	SIN59;18
 .EQU	SIN99=	SIN58;20
 .EQU	SIN100=	SIN57;22
 .EQU	SIN101=	SIN56;24
 .EQU	SIN102=	SIN55;26
 .EQU	SIN103=	SIN54;28
 .EQU	SIN104=	SIN53;30
 .EQU	SIN105=	SIN52;32
 .EQU	SIN106=	SIN51;34
 .EQU	SIN107= SIN50;37
 .EQU	SIN108=	SIN49;39
 .EQU	SIN109=	SIN48;41
 .EQU	SIN110=	SIN47;44
 .EQU	SIN111=	SIN46;46
 .EQU	SIN112=	SIN45;48
 .EQU	SIN113=	SIN44;51
 .EQU	SIN114=	SIN43;53
 .EQU	SIN115=	SIN42;56
 .EQU	SIN116=	SIN41;58
 .EQU	SIN117=	SIN40;61
 .EQU	SIN118=	SIN39;64
 .EQU	SIN119=	SIN38;66
 .EQU	SIN120=	SIN37;69
 .EQU	SIN121=	SIN36;71
 .EQU	SIN122=	SIN35;74
 .EQU	SIN123=	SIN34;76
 .EQU	SIN124=	SIN33;79
 .EQU	SIN125=	SIN32;81
 .EQU	SIN126=	SIN31;83
 .EQU	SIN127=	SIN30;86
 .EQU	SIN128=	SIN29;88
 .EQU	SIN129=	SIN28;90
 .EQU	SIN130=	SIN27;93
 .EQU	SIN131=	SIN26;95
 .EQU	SIN132=	SIN25;97
 .EQU	SIN133=	SIN24;99
 .EQU	SIN134=	SIN23;101
 .EQU	SIN135=	SIN22;103
 .EQU	SIN136=	SIN21;105
 .EQU	SIN137=	SIN20;107
 .EQU	SIN138=	SIN19;109
 .EQU	SIN139=	SIN18;111
 .EQU	SIN140=	SIN17;112
 .EQU	SIN141=	SIN16;114
 .EQU	SIN142=	SIN15;115
 .EQU	SIN143=	SIN14;117
 .EQU	SIN144=	SIN13;118
 .EQU	SIN145=	SIN12;119
 .EQU	SIN146=	SIN11;120
 .EQU	SIN147=	SIN10;122
 .EQU	SIN148=	SIN9;123
 .EQU	SIN149=	SIN8;123
 .EQU	SIN150=	SIN7;124
 .EQU	SIN151=	SIN6;125
 .EQU	SIN152=	SIN5;125
 .EQU	SIN153=	SIN4;126
 .EQU	SIN154=	SIN3;126
 .EQU	SIN155=	SIN2;127
 .EQU	SIN156=	SIN1;127
 .EQU	SIN157=	SIN0;127
;--------------------------
.exit
 .EQU	SIN1=0b11110111;127
 .EQU	SIN2=0b11110111;127
 .EQU	SIN3=0b11110110;126
 .EQU	SIN4=0b11110110;126
 .EQU	SIN5=0b11110101;125
 .EQU	SIN6=0b11110101;125
 .EQU	SIN7=0b11110100;124
 .EQU	SIN8=0b11110011;123
 .EQU	SIN9=0b11110011;123
 .EQU	SIN10=0b11110010;122
 .EQU	SIN11=0b11110000;120
 .EQU	SIN12=0b11100111;119
 .EQU	SIN13=0b11100110;118
 .EQU	SIN14=0b11100101;117
 .EQU	SIN15=0b11100011;115
 .EQU	SIN16=0b11100010;114
 .EQU	SIN17=0b11100000;112
 .EQU	SIN18=0b11010111;111
 .EQU	SIN19=0b11010101;109
 .EQU	SIN20=0b11010011;107
 .EQU	SIN21=0b11010001;105
 .EQU	SIN22=0b11000111;103
 .EQU	SIN23=0b11000101;101
 .EQU	SIN24=0b11000011;99
 .EQU	SIN25=0b11000001;97
 .EQU	SIN26=0b10110111;95
 .EQU	SIN27=0b10110101;93
 .EQU	SIN28=0b10110010;90
 .EQU	SIN29=0b10110000;88
 .EQU	SIN30=0b10100110;86
 .EQU	SIN31=0b10100011;83
 .EQU	SIN32=0b10100001;81
 .EQU	SIN33=0b10010111;79
 .EQU	SIN34=0b10010100;76
 .EQU	SIN35=0b10010010;74
 .EQU	SIN36=0b10000111;71
 .EQU	SIN37=0b10000101;69
 .EQU	SIN38=0b10000010;66
 .EQU	SIN39=0b10000000;64
 .EQU	SIN40=0b01110101;61
 .EQU	SIN41=0b01110010;58
 .EQU	SIN42=0b01110000;56
 .EQU	SIN43=0b01100101;53
 .EQU	SIN44=0b01100011;51
 .EQU	SIN45=0b01100000;48
 .EQU	SIN46=0b01010110;46
 .EQU	SIN47=0b01010100;44
 .EQU	SIN48=0b01010001;41
 .EQU	SIN49=0b01000111;39
 .EQU	SIN50=0b01000101;37
 .EQU	SIN51=0b01000010;34
 .EQU	SIN52=0b01000000;32
 .EQU	SIN53=0b00110110;30
 .EQU	SIN54=0b00110100;28
 .EQU	SIN55=0b00110010;26
 .EQU	SIN56=0b00110000;24
 .EQU	SIN57=0b00100110;22
 .EQU	SIN58=0b00100100;20
 .EQU	SIN59=0b00100010;18
 .EQU	SIN60=0b00100000;16
 .EQU	SIN61=0b00010111;15
 .EQU	SIN62=0b00010101;13
 .EQU	SIN63=0b00010100;12
 .EQU	SIN64=0b00010010;10
 .EQU	SIN65=0b00010001;9
 .EQU	SIN66=0b00010000;8
 ;ponizej 8 nie trzeba pzesowac bitow
 .EQU	SIN67=7
 .EQU	SIN68=5
 .EQU	SIN69=4
 .EQU	SIN70=4
 .EQU	SIN71=3
 .EQU	SIN72=2
 .EQU	SIN73=2
 .EQU	SIN74=1
 .EQU	SIN75=1
 .EQU	SIN76=0
 .EQU	SIN77=0
 .EQU	SIN78=0
 .EQU	SIN79=0
 .EQU	SIN80=0
 .EQU	SIN81=0
 .EQU	SIN82=1
 .EQU	SIN83=1
 .EQU	SIN84=2
 .EQU	SIN85=2
 .EQU	SIN86=3
 .EQU	SIN87=4
 .EQU	SIN88=4
 .EQU	SIN89=5
 .EQU	SIN90=7
 .EQU	SIN91=0b00010000;8
 .EQU	SIN92=0b00010001;9
 .EQU	SIN93=0b00010010;10
 .EQU	SIN94=0b00010100;12
 .EQU	SIN95=0b00010101;13
 .EQU	SIN96=0b00010111;15
 .EQU	SIN97=0b00100000;16
 .EQU	SIN98=0b00100010;18
 .EQU	SIN99=0b00100100;20
 .EQU	SIN100=0b00100110;22
 .EQU	SIN101=0b00110000;24
 .EQU	SIN102=0b00110010;26
 .EQU	SIN103=0b00110100;28
 .EQU	SIN104=0b00110110;30
 .EQU	SIN105=0b01000000;32
 .EQU	SIN106=0b01000010;34
 .EQU	SIN107=0b01000101;37
 .EQU	SIN108=0b01000111;39
 .EQU	SIN109=0b01010001;41
 .EQU	SIN110=0b01010100;44
 .EQU	SIN111=0b01010110;46
 .EQU	SIN112=0b01100000;48
 .EQU	SIN113=0b01100011;51
 .EQU	SIN114=0b01100101;53
 .EQU	SIN115=0b01110000;56
 .EQU	SIN116=0b01110010;58
 .EQU	SIN117=0b01110101;61
 .EQU	SIN118=0b10000000;64
 .EQU	SIN119=0b10000010;66
 .EQU	SIN120=0b10000101;69
 .EQU	SIN121=0b10000111;71
 .EQU	SIN122=0b10010010;74
 .EQU	SIN123=0b10010100;76
 .EQU	SIN124=0b10010111;79
 .EQU	SIN125=0b10100001;81
 .EQU	SIN126=0b10100011;83
 .EQU	SIN127=0b10100110;86
 .EQU	SIN128=0b10110000;88
 .EQU	SIN129=0b10110010;90
 .EQU	SIN130=0b10110101;93
 .EQU	SIN131=0b10110111;95
 .EQU	SIN132=0b11000001;97
 .EQU	SIN133=0b11000011;99
 .EQU	SIN134=0b11000101;101
 .EQU	SIN135=0b11000111;103
 .EQU	SIN136=0b11010001;105
 .EQU	SIN137=0b11010011;107
 .EQU	SIN138=0b11010101;109
 .EQU	SIN139=0b11010111;111
 .EQU	SIN140=0b11100000;112
 .EQU	SIN141=0b11100010;114
 .EQU	SIN142=0b11100011;115
 .EQU	SIN143=0b11100101;117
 .EQU	SIN144=0b11100110;118
 .EQU	SIN145=0b11100111;119
 .EQU	SIN146=0b11110000;120
 .EQU	SIN147=0b11110010;122
 .EQU	SIN148=0b11110011;123
 .EQU	SIN149=0b11110011;123
 .EQU	SIN150=0b11110100;124
 .EQU	SIN151=0b11110101;125
 .EQU	SIN152=0b11110101;125
 .EQU	SIN153=0b11110110;126
 .EQU	SIN154=0b11110110;126
 .EQU	SIN155=0b11110111;127
 .EQU	SIN156=0b11110111;127
 .EQU	SIN157=0b11110111;127
 .EQU	SIN158=0b11110111;127
